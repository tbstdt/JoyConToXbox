## sdkconfig.defaults
```kconfig
# Bluetooth Configuration
# BTDM (Bluetooth Dual Mode): BLE для HID эмуляции Xbox, Classic для Joy-Con
# USB недоступен на обычном ESP32, используем BLE HID для эмуляции Xbox контроллера

# Общие настройки Bluetooth
CONFIG_BT_ENABLED=y

# Bluetooth Classic (Bluedroid) для Joy-Con
CONFIG_BT_BLUEDROID_ENABLED=y
CONFIG_BT_CLASSIC_ENABLED=y
CONFIG_BT_BLE_ENABLED=y

# BTDM режим контроллера (одновременно BLE и Classic)
CONFIG_BTDM_CTRL_MODE_BTDM=y
CONFIG_BTDM_CTRL_BLE_MAX_CONN=3
CONFIG_BTDM_CTRL_BR_EDR_MAX_ACL_CONN=2
CONFIG_BTDM_CTRL_BR_EDR_MAX_SYNC_CONN=0

# Bluedroid Classic и BLE настройки (BTDM режим)
CONFIG_BT_CLASSIC_BLE_ENABLED=y
CONFIG_BT_GATTS_ENABLE=y
CONFIG_BT_GATTC_ENABLE=y
CONFIG_BT_BLE_SMP_ENABLE=y
CONFIG_BT_HID_ENABLED=y
CONFIG_BT_HID_HOST_ENABLED=y
CONFIG_BT_SSP_ENABLED=y

# L2CAP для Joy-Con HID каналов
CONFIG_BT_L2CAP_ENABLED=y

# Отключаем NimBLE, так как используем Bluedroid в BTDM режиме
# CONFIG_BT_NIMBLE_ENABLED is not set

# FreeRTOS Configuration
CONFIG_FREERTOS_HZ=1000
CONFIG_FREERTOS_ASSERT_ON_UNTESTED_FUNCTION=y
CONFIG_ESP_MAIN_TASK_STACK_SIZE=8192

# Memory Configuration
CONFIG_SPIRAM_SUPPORT=n
CONFIG_ESP32_DEFAULT_CPU_FREQ_240=y

# Logging
CONFIG_LOG_DEFAULT_LEVEL_INFO=y
CONFIG_LOG_MAXIMUM_LEVEL_VERBOSE=y

# Component Configuration
CONFIG_COMPILER_OPTIMIZATION_SIZE=n
CONFIG_COMPILER_OPTIMIZATION_PERF=y
```
